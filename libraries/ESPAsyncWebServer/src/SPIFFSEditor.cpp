#include "SPIFFSEditor.h"
#include <FS.h>


//File: edit.htm.gz, Size: 4924
#define edit_htm_gz_len 4924
const uint8_t edit_htm_gz[] PROGMEM = {
 0x1f, 0x8b, 0x08, 0x08, 0xad, 0x0c, 0x82, 0x58, 0x02, 0x03, 0x65, 0x64, 0x69, 0x74, 0x2d, 0x33, 
0x2e, 0x68, 0x74, 0x6d, 0x6c, 0x00, 0xb5, 0x59, 0x0d, 0x5b, 0xdb, 0xb8, 0xb2, 0xfe, 0x2b, 0xc6, 
0x3d, 0xcb, 0xda, 0x27, 0x8e, 0x93, 0x00, 0x65, 0x5b, 0x07, 0xc3, 0x26, 0x40, 0x0b, 0xa5, 0x7c, 
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0xdd, 0xff, 0x05, 0x1c, 0x0e, 0x69, 0xd9, 0x6d, 0x27, 0x00, 0x00
};

// WEB HANDLER IMPLEMENTATION

SPIFFSEditor::SPIFFSEditor(const String& username, const String& password)
:_username(username)
,_password(password)
,_authenticated(false)
,_startTime(0)
{}

bool SPIFFSEditor::canHandle(AsyncWebServerRequest *request){
  if(request->url().equalsIgnoreCase("/edit")){
    if(request->method() == HTTP_GET){
      if(request->hasParam("list"))
        return true;
      if(request->hasParam("edit")){
        request->_tempFile = SPIFFS.open(request->arg("edit"), "r");
        if(!request->_tempFile)
          return false;
      }
      if(request->hasParam("download")){
        request->_tempFile = SPIFFS.open(request->arg("download"), "r");
        if(!request->_tempFile)
          return false;
      }
      return true;
    }
    else if(request->method() == HTTP_POST)
      return true;
    else if(request->method() == HTTP_DELETE)
      return true;
    else if(request->method() == HTTP_PUT)
      return true;

  }
  return false;
}

void SPIFFSEditor::handleRequest(AsyncWebServerRequest *request){
  if(_username.length() && _password.length() && !request->authenticate(_username.c_str(), _password.c_str()))
    return request->requestAuthentication();

  if(request->method() == HTTP_GET){
    if(request->hasParam("list")){
      String path = request->getParam("list")->value();
      Dir dir = SPIFFS.openDir(path);
      path = String();
      String output = "[";
      while(dir.next()){
        fs::File entry = dir.openFile("r");
        Serial.println(String(entry.name()));
        if (String(entry.name()).equals("/ace.js"))  { continue; }
        if (String(entry.name()).equals("/mode-css.js"))  { continue; }
        if (String(entry.name()).equals("/mode-html.js")) { continue; }
        if (String(entry.name()).equals("/worker-html.js"))  { continue; }
        Serial.println("continue...");
        if (output != "[") output += ',';
        bool isDir = false;
        output += "{\"type\":\"";
        output += (isDir)?"dir":"file";
        output += "\",\"name\":\"";
        output += String(entry.name()).substring(1);
        output += "\",\"size\":";
        output += String(entry.size());
        output += "}";
        entry.close();
      }
      output += "]";
      request->send(200, "text/json", output);
      output = String();
    }
    else if(request->hasParam("edit") || request->hasParam("download")){
      request->send(request->_tempFile, request->_tempFile.name(), String(), request->hasParam("download"));
    }
    else {
      AsyncWebServerResponse *response = request->beginResponse_P(200, "text/html", edit_htm_gz, edit_htm_gz_len);
      response->addHeader("Content-Encoding", "gzip");
      request->send(response);
    }
  } else if(request->method() == HTTP_DELETE){
    if(request->hasParam("path", true)){
      SPIFFS.remove(request->getParam("path", true)->value());
      request->send(200, "", "DELETE: "+request->getParam("path", true)->value());
    } else
      request->send(404);
  } else if(request->method() == HTTP_POST){
    if(request->hasParam("data", true, true) && SPIFFS.exists(request->getParam("data", true, true)->value()))
      request->send(200, "", "UPLOADED: "+request->getParam("data", true, true)->value());
    else
      request->send(500);
  } else if(request->method() == HTTP_PUT){
    if(request->hasParam("path", true)){
      String filename = request->getParam("path", true)->value();
      if(SPIFFS.exists(filename)){
        request->send(200);
      } else {
        fs::File f = SPIFFS.open(filename, "w");
        if(f){
          f.write((uint8_t)0x00);
          f.close();
          request->send(200, "", "CREATE: "+filename);
        } else {
          request->send(500);
        }
      }
    } else
      request->send(400);
  }
}

void SPIFFSEditor::handleUpload(AsyncWebServerRequest *request, const String& filename, size_t index, uint8_t *data, size_t len, bool final){
  if(!index){
    if(!_username.length() || request->authenticate(_username.c_str(),_password.c_str())){
      _authenticated = true;
      request->_tempFile = SPIFFS.open(filename, "w");
      _startTime = millis();
    }
  }
  if(_authenticated && request->_tempFile){
    if(len){
      request->_tempFile.write(data,len);
    }
    if(final){
      request->_tempFile.close();
    }
  }
}
